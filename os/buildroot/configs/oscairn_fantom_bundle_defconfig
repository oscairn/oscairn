## os/buildroot/package/oscairn/Config.in
```kconfig
config BR2_PACKAGE_OSCAIRN
	bool "oscairn"
	depends on BR2_INSTALL_LIBSTDCPP
	depends on BR2_TOOLCHAIN_HAS_THREADS
	depends on BR2_TOOLCHAIN_GCC_AT_LEAST_12 # C++20
	help
	  Oscairn, an open instrument platform: the plugin host core,
	  the first-party CLAP plugins (installed to /usr/lib/clap) and
	  oscairn-render.

	  https://github.com/oscairn/oscairn

if BR2_PACKAGE_OSCAIRN

config BR2_PACKAGE_OSCAIRN_LV2
	bool "LV2 plugin hosting"
	depends on !BR2_STATIC_LIBS
	select BR2_PACKAGE_LILV
	help
	  Load LV2 bundles alongside CLAP plugins, using Lilv. Supports
	  audio/control ports and MIDI/time atom sequences. Plugins must
	  be built for the target architecture and supported extensions.

config BR2_PACKAGE_OSCAIRN_ENGINE
	bool "audio engine (JUCE, ALSA)"
	depends on BR2_TOOLCHAIN_USES_GLIBC
	select BR2_PACKAGE_OSCAIRN_JUCE
	select BR2_PACKAGE_ALSA_LIB
	select BR2_PACKAGE_LIBCURL # HTTPS for package repositories
	help
	  oscairn-engine: the audio and MIDI engine, with its control
	  socket. The app starts it; without a display (a profile with
	  no screen, or none attached) the session runs it alone. Needs
	  no X11.

config BR2_PACKAGE_OSCAIRN_STANDALONE
	bool "desktop app (JUCE, X11)"
	depends on BR2_PACKAGE_XORG7
	depends on BR2_TOOLCHAIN_USES_GLIBC
	select BR2_PACKAGE_OSCAIRN_ENGINE
	select BR2_PACKAGE_FREETYPE
	select BR2_PACKAGE_FONTCONFIG
	select BR2_PACKAGE_XLIB_LIBX11
	select BR2_PACKAGE_XLIB_LIBXEXT
	select BR2_PACKAGE_XLIB_LIBXINERAMA
	select BR2_PACKAGE_XLIB_LIBXRANDR
	select BR2_PACKAGE_XLIB_LIBXCURSOR
	select BR2_PACKAGE_XLIB_LIBXRENDER
	help
	  The Oscairn app with its screen and panel layouts, built
	  with JUCE. Needs an X11 display. It is the only part of the
	  image that uses JUCE or X11.

comment "the desktop app needs X.org and a glibc toolchain"
	depends on !BR2_PACKAGE_XORG7 || !BR2_TOOLCHAIN_USES_GLIBC

config BR2_PACKAGE_OSCAIRN_ROLAND_FANTOM0
	bool "Roland FANTOM-0 panel and keys"
	help
	  Builds the engine's readers for a Roland FANTOM-0's panel
	  (its I2C messages) and keys (its link to the sound chips),
	  shared by the FANTOM-06, -07 and -08 (OSCAIRN_ROLAND_FANTOM0),
	  with oscairn-panel-dump and the panel maps, for a product
	  whose profile has panel.protocol "roland-i2c-slave" or
	  keyboard.protocol "roland-bmc-stock".

config BR2_PACKAGE_OSCAIRN_USB_GADGET
	bool "USB device mode (MIDI and audio to a computer)"
	depends on BR2_LINUX_KERNEL
	help
	  Keeps the kernel's USB gadget support (configfs, with its
	  MIDI and UAC2 functions) for a product whose profile has
	  midi.usbDevice. Off, the kernel has no gadget code, whatever
	  the board's kernel config lists (RFC 0035, optional hardware).

config BR2_PACKAGE_OSCAIRN_REALTIME_KERNEL
	bool "real-time kernel (PREEMPT_RT)"
	depends on BR2_LINUX_KERNEL
	help
	  Builds the image's kernel with PREEMPT_RT (and EXPERT, which
	  it depends on): interrupts threaded, spinlocks preemptible,
	  for a bounded worst-case latency (RFC 0035). Mainline since
	  Linux 6.12 on ARM64, so no patch. For instrument and
	  pass-through products; measure with cyclictest (rt-tests).

endif

comment "oscairn needs a toolchain w/ C++, threads, gcc >= 12"
	depends on !BR2_INSTALL_LIBSTDCPP || !BR2_TOOLCHAIN_HAS_THREADS || \
		!BR2_TOOLCHAIN_GCC_AT_LEAST_12
```
