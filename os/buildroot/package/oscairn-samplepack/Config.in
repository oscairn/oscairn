## os/buildroot/package/oscairn-samplepack/Config.in
```kconfig
config BR2_PACKAGE_OSCAIRN_SAMPLEPACK
	bool
	help
	  The samplepack source (Oscairn Sample Packs and waveforms),
	  for the oscairn package, which builds its static library
	  with cargo. Nothing is installed on the target.
```

## os/buildroot/package/oscairn-ui-crates/Config.in
```kconfig
config BR2_PACKAGE_OSCAIRN_UI_CRATES
	bool
	help
	  The crates the Rust UI (oscairn-ui) builds with, from
	  crates.io at the download step, checked against its
	  Cargo.lock, for the oscairn package to build it offline.
	  Nothing is installed on the target.
```
